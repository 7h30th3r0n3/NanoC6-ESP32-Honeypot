/*
 * ESP32 Honeypot SIEM — Local dashboard with ring buffer storage
 * Banner grab only (no telnet shell) for maximum log retention
 */

#include <WiFi.h>
#include <WiFiClient.h>
#include <SPIFFS.h>
#include <ESPAsyncWebServer.h>
#include <ArduinoJson.h>
#include <HTTPClient.h>
#include <time.h>
#include <algorithm>
#include <vector>

// ──────────────── Paths & Constants ────────────────
static const char* CONFIG_PATH     = "/config.json";
static const char* EVENTS_PATH     = "/events.bin";
static const char* EVENTS_VFS_PATH = "/spiffs/events.bin";
static const char* STATS_PATH      = "/stats.json";

#define RECORD_SIZE  138
#define HEADER_SIZE   8
#define PAYLOAD_LEN  128
#define PORT_COUNT   14
#define MAX_TOP_IPS  20

static const uint16_t PORT_LIST[PORT_COUNT] = {
  21, 22, 23, 25, 53, 110, 143, 443, 445, 3306, 3389, 5900, 8080, 11434
};
static const char* PORT_NAMES[PORT_COUNT] = {
  "FTP","SSH","Telnet","SMTP","DNS","POP3","IMAP",
  "HTTPS","SMB","MySQL","RDP","VNC","HTTP-Alt","Ollama"
};

// ──────────────── Ring Buffer Record ────────────────
struct __attribute__((packed)) EventRecord {
  uint32_t timestamp;
  uint32_t ip;
  uint16_t port;
  char     payload[PAYLOAD_LEN];
};

// ──────────────── Ring Buffer State ─────────────────
uint32_t ringWritePos   = 0;
uint32_t ringTotalCount = 0;
uint32_t ringCapacity   = 0;

// ──────────────── Stats ─────────────────────────────
uint32_t portCounts[PORT_COUNT] = {};
struct TopIPEntry { uint32_t ip; uint32_t count; };
TopIPEntry topIPs[MAX_TOP_IPS] = {};
uint8_t  topIPCount    = 0;
uint16_t weeklyBuckets[7][24] = {};
uint8_t  lastStatsHour = 255;
uint8_t  lastStatsDay  = 255;
uint32_t totalAllTime  = 0;
uint32_t lastStatsSave = 0;

// ──────────────── Network ───────────────────────────
String ssid, password, WebhookURL;
std::vector<uint16_t> enabledPorts;

WiFiServer ftpServer(21),  sshServer(22),  telnetServer(23),
           smtpServer(25), dnsServer(53),  pop3Server(110),
           imapServer(143),httpsServer(443),smbServer(445),
           mysqlServer(3306), rdpServer(3389),
           vncServer(5900), ahttpServer(8080),
           ollamaServer(11434);

AsyncWebServer  webServer(80);
AsyncEventSource sseStream("/api/stream");
bool honeypotActive = false;

// ──────────────── Dashboard HTML (gzipped PROGMEM) ──────────
static const uint8_t DASHBOARD_HTML_GZ[] PROGMEM = {
  0x1f,0x8b,0x08,0x00,0xc3,0xd7,0x75,0x6a,0x02,0xff,0xad,0x3b,0x6b,0x77,0x9b,0x48,0x96,0xdf,0xfd,0x2b,
  0x68,0xc5,0x09,0xd0,0x46,0x08,0xf4,0xb2,0x8c,0x8c,0x3c,0x69,0x27,0x39,0xf1,0xae,0x93,0xf6,0xb6,0x9d,
  0xee,0x9d,0xe3,0xf1,0x19,0x23,0x28,0x24,0x3a,0xbc,0x16,0x4a,0xb2,0x3c,0x84,0x73,0xf6,0x47,0xec,0x2f,
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  0xcf,0xf3,0x77,0x63,0xf6,0xd7,0xce,0xff,0x07,0x27,0xe6,0x74,0xc8,0xfd,0x3c,0x00,0x00
};
static const size_t DASHBOARD_HTML_GZ_LEN = sizeof(DASHBOARD_HTML_GZ);

// ──────────────── Setup Page HTML (gzipped PROGMEM) ─────────
static const uint8_t SETUP_HTML_GZ[] PROGMEM = {
  0x1f,0x8b,0x08,0x00,0xc3,0xd7,0x75,0x6a,0x02,0xff,0xa5,0x58,0x6d,0x6f,0xdb,0x36,0x10,0xfe,0xee,0x5f,
  0xc1,0xaa,0xdb,0x24,0x0d,0xb1,0xfc,0x9e,0xb9,0xb2,0xe5,0xa1,0x6b,0x1a,0x34,0xc3,0xda,0x78,0xb5,0xb7,
  0x61,0x28,0x02,0x8c,0xa2,0x28,0x8b,0x35,0x2d,0x6a,0x12,0x15,0xc7,0xd3,0xfc,0xdf,0x77,0xa4,0x24,0xc7,
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  0x33,0xdc,0x7f,0xd5,0x3f,0x2a,0xfe,0x01,0xc9,0xe5,0xa0,0x6c,0xbe,0x10,0x00,0x00
};
static const size_t SETUP_HTML_GZ_LEN = sizeof(SETUP_HTML_GZ);

// ──────────────── Utility Functions ─────────────────
uint32_t ipToUint32(IPAddress ip) {
  return ((uint32_t)ip[0] << 24) | ((uint32_t)ip[1] << 16) |
         ((uint32_t)ip[2] << 8)  | ip[3];
}

void uint32ToIP(uint32_t ip, char* buf) {
  snprintf(buf, 16, "%u.%u.%u.%u",
    (ip >> 24) & 0xFF, (ip >> 16) & 0xFF,
    (ip >> 8) & 0xFF, ip & 0xFF);
}

uint32_t getEpoch() {
  time_t now;
  time(&now);
  return (now > 1700000000) ? (uint32_t)now : millis() / 1000;
}

int portIndex(uint16_t port) {
  for (int i = 0; i < PORT_COUNT; i++)
    if (PORT_LIST[i] == port) return i;
  return -1;
}

// ──────────────── Ring Buffer ───────────────────────
void ringInit() {
  size_t totalBytes = SPIFFS.totalBytes();
  size_t reserved   = 50 * 1024;
  size_t available  = totalBytes > reserved ? totalBytes - reserved : 0;
  ringCapacity = available / RECORD_SIZE;
  if (ringCapacity > 200000) ringCapacity = 200000;
  if (ringCapacity < 100)    ringCapacity = 100;

  if (SPIFFS.exists(EVENTS_PATH)) {
    File f = SPIFFS.open(EVENTS_PATH, FILE_READ);
    if (f && f.size() >= HEADER_SIZE) {
      f.read((uint8_t*)&ringWritePos, 4);
      f.read((uint8_t*)&ringTotalCount, 4);
      f.close();
      if (ringWritePos >= ringCapacity) ringWritePos = 0;
      Serial.printf("[+] Ring: %u/%u used, %u total\n",
        min(ringTotalCount, ringCapacity), ringCapacity, ringTotalCount);
      return;
    }
    if (f) f.close();
  }

  File f = SPIFFS.open(EVENTS_PATH, FILE_WRITE);
  if (f) {
    ringWritePos = 0;
    ringTotalCount = 0;
    f.write((uint8_t*)&ringWritePos, 4);
    f.write((uint8_t*)&ringTotalCount, 4);
    f.close();
  }
  Serial.printf("[+] Ring: created, capacity=%u\n", ringCapacity);
}

void ringWrite(const EventRecord& rec) {
  FILE* f = fopen(EVENTS_VFS_PATH, "r+b");
  if (!f) return;

  long offset = HEADER_SIZE + (long)ringWritePos * RECORD_SIZE;
  fseek(f, offset, SEEK_SET);
  fwrite(&rec, 1, RECORD_SIZE, f);

  ringWritePos = (ringWritePos + 1) % ringCapacity;
  ringTotalCount++;

  fseek(f, 0, SEEK_SET);
  fwrite(&ringWritePos, 4, 1, f);
  fwrite(&ringTotalCount, 4, 1, f);
  fflush(f);
  fclose(f);
}

// ──────────────── Stats ─────────────────────────────
void loadStats() {
  if (!SPIFFS.exists(STATS_PATH)) return;
  File f = SPIFFS.open(STATS_PATH, FILE_READ);
  if (!f) return;
  JsonDocument doc;
  if (deserializeJson(doc, f)) { f.close(); return; }
  f.close();

  totalAllTime  = doc["total"] | 0;
  lastStatsHour = doc["lastHour"] | 255;
  lastStatsDay  = doc["lastDay"] | 255;
  JsonArray pa  = doc["ports"].as<JsonArray>();
  for (int i = 0; i < PORT_COUNT && i < (int)pa.size(); i++)
    portCounts[i] = pa[i];
  JsonArray ia = doc["ips"].as<JsonArray>();
  topIPCount = 0;
  for (int i = 0; i < MAX_TOP_IPS && i < (int)ia.size(); i++) {
    topIPs[i].ip    = ia[i][0];
    topIPs[i].count = ia[i][1];
    topIPCount++;
  }
  JsonArray ha = doc["heatmap"].as<JsonArray>();
  for (int d = 0; d < 7 && d < (int)ha.size(); d++) {
    JsonArray row = ha[d].as<JsonArray>();
    for (int h = 0; h < 24 && h < (int)row.size(); h++)
      weeklyBuckets[d][h] = row[h];
  }
}

void saveStats() {
  JsonDocument doc;
  doc["total"]    = totalAllTime;
  doc["lastHour"] = lastStatsHour;
  doc["lastDay"]  = lastStatsDay;
  JsonArray pa = doc["ports"].to<JsonArray>();
  for (int i = 0; i < PORT_COUNT; i++) pa.add(portCounts[i]);
  JsonArray ia = doc["ips"].to<JsonArray>();
  for (int i = 0; i < topIPCount; i++) {
    JsonArray e = ia.add<JsonArray>();
    e.add(topIPs[i].ip);
    e.add(topIPs[i].count);
  }
  JsonArray ha = doc["heatmap"].to<JsonArray>();
  for (int d = 0; d < 7; d++) {
    JsonArray row = ha.add<JsonArray>();
    for (int h = 0; h < 24; h++) row.add(weeklyBuckets[d][h]);
  }

  File f = SPIFFS.open(STATS_PATH, FILE_WRITE);
  if (f) { serializeJson(doc, f); f.close(); }
  lastStatsSave = millis();
}

void updateStats(const EventRecord& rec) {
  totalAllTime++;

  int idx = portIndex(rec.port);
  if (idx >= 0) portCounts[idx]++;

  bool found = false;
  for (int i = 0; i < topIPCount; i++) {
    if (topIPs[i].ip == rec.ip) { topIPs[i].count++; found = true; break; }
  }
  if (!found) {
    if (topIPCount < MAX_TOP_IPS) {
      topIPs[topIPCount] = {rec.ip, 1};
      topIPCount++;
    } else {
      int minIdx = 0;
      for (int i = 1; i < MAX_TOP_IPS; i++)
        if (topIPs[i].count < topIPs[minIdx].count) minIdx = i;
      if (topIPs[minIdx].count <= 1)
        topIPs[minIdx] = {rec.ip, 1};
    }
  }

  struct tm ti;
  if (getLocalTime(&ti)) {
    uint8_t d = ti.tm_wday, h = ti.tm_hour;
    if (d != lastStatsDay) {
      memset(weeklyBuckets[d], 0, sizeof(weeklyBuckets[d]));
      lastStatsDay = d;
    }
    if (h != lastStatsHour) { weeklyBuckets[d][h] = 0; lastStatsHour = h; }
    if (weeklyBuckets[d][h] < 65535) weeklyBuckets[d][h]++;
  }

  if (totalAllTime % 50 == 0 || millis() - lastStatsSave > 300000)
    saveStats();
}

// ──────────────── SSE Notify ────────────────────────
void notifySSE(const EventRecord& rec) {
  if (sseStream.count() == 0) return;
  char ip[16];
  uint32ToIP(rec.ip, ip);
  char escaped[PAYLOAD_LEN * 2 + 1];
  int j = 0;
  for (int i = 0; i < PAYLOAD_LEN && rec.payload[i]; i++) {
    char c = rec.payload[i];
    if (c == '"' || c == '\\') escaped[j++] = '\\';
    if (c >= 32) escaped[j++] = c;
  }
  escaped[j] = 0;
  char json[200];
  snprintf(json, sizeof(json),
    "{\"t\":%u,\"ip\":\"%s\",\"p\":%u,\"d\":\"%s\"}",
    rec.timestamp, ip, rec.port, escaped);
  sseStream.send(json, "event", millis());
}

// ──────────────── Event Logging ─────────────────────
void logEvent(const String& ipStr, uint16_t port, const String& data) {
  EventRecord rec;
  rec.timestamp = getEpoch();
  IPAddress addr;
  addr.fromString(ipStr);
  rec.ip   = ipToUint32(addr);
  rec.port = port;
  memset(rec.payload, 0, PAYLOAD_LEN);
  int len = min((int)data.length(), PAYLOAD_LEN);
  memcpy(rec.payload, data.c_str(), len);

  ringWrite(rec);
  updateStats(rec);
  notifySSE(rec);
  Serial.printf("[SIEM] %s:%u %.*s\n", ipStr.c_str(), port, PAYLOAD_LEN, rec.payload);

  if (WiFi.status() == WL_CONNECTED && WebhookURL.length() > 0) {
    HTTPClient http;
    http.begin(WebhookURL);
    http.addHeader("Content-Type", "application/json");
    char ip[16]; uint32ToIP(rec.ip, ip);
    String msg = "{\"content\":\"**Honeypot SIEM**\\nIP: `";
    msg += ip; msg += "`\\nPort: `"; msg += rec.port;
    msg += "`\\nPayload: `"; msg += data.substring(0, 50);
    msg += "`\"}";
    http.POST(msg);
    http.end();
  }
}

// ──────────────── Banner Grab ───────────────────────
String dumpBytes(WiFiClient& c, size_t maxLen = 256, uint32_t timeout = 300) {
  String s;
  unsigned long t0 = millis();
  while (millis() - t0 < timeout && s.length() < maxLen && c.connected()) {
    while (c.available() && s.length() < maxLen) {
      uint8_t b = c.read();
      if (isprint(b) || b == '\r' || b == '\n') s += (char)b;
      else { char buf[5]; sprintf(buf, "\\x%02X", b); s += buf; }
    }
    delay(1);
  }
  return s.length() ? s : "(no data)";
}

// Client-speaks-first: read probe, then send response (HTTP, DNS, SMB, RDP)
void handleBanner(WiFiClient client, uint16_t port, const char* banner) {
  if (!client.connected()) return;
  String ip = client.remoteIP().toString();
  String payload = dumpBytes(client);
  client.write((const uint8_t*)banner, strlen(banner));
  delay(50);
  client.stop();
  logEvent(ip, port, payload);
}

void handleBanner(WiFiClient client, uint16_t port, const uint8_t* banner, size_t len) {
  if (!client.connected()) return;
  String ip = client.remoteIP().toString();
  String payload = dumpBytes(client);
  client.write(banner, len);
  delay(50);
  client.stop();
  logEvent(ip, port, payload);
}

// Server-speaks-first: send banner immediately, then read probe (RFC-correct)
void handleServerBanner(WiFiClient client, uint16_t port, const char* banner) {
  if (!client.connected()) return;
  String ip = client.remoteIP().toString();
  client.write((const uint8_t*)banner, strlen(banner));
  String payload = dumpBytes(client, 256, 500);
  client.stop();
  logEvent(ip, port, payload);
}

void handleServerBanner(WiFiClient client, uint16_t port, const uint8_t* banner, size_t len) {
  if (!client.connected()) return;
  String ip = client.remoteIP().toString();
  client.write(banner, len);
  String payload = dumpBytes(client, 256, 500);
  client.stop();
  logEvent(ip, port, payload);
}

// ──────────────── Ollama Honeypot ────────────────────
String extractJsonStr(const String& json, const char* key) {
  String k = String("\"") + key + "\"";
  int idx = json.indexOf(k);
  if (idx < 0) return "";
  idx = json.indexOf(":", idx + k.length());
  if (idx < 0) return "";
  idx = json.indexOf("\"", idx + 1);
  if (idx < 0) return "";
  int start = idx + 1, end = start;
  while (end < (int)json.length()) {
    if (json[end] == '\\') { end += 2; continue; }
    if (json[end] == '"') break;
    end++;
  }
  return json.substring(start, min(end, start + 200));
}

String escapeJsonStr(const String& s) {
  String r;
  for (int i = 0; i < (int)s.length() && i < 200; i++) {
    char c = s[i];
    if (c == '"') r += "\\\"";
    else if (c == '\\') r += "\\\\";
    else if (c == '\n') r += "\\n";
    else if (c == '\r') r += "\\r";
    else if (c >= 32) r += c;
  }
  return r;
}

void handleOllama(WiFiClient client) {
  if (!client.connected()) return;
  String ip = client.remoteIP().toString();

  String req;
  unsigned long t0 = millis();
  while (client.connected() && millis() - t0 < 3000 && req.length() < 4096) {
    while (client.available() && req.length() < 4096)
      req += (char)client.read();
    if (req.indexOf("\r\n\r\n") >= 0) {
      int clIdx = req.indexOf("Content-Length:");
      if (clIdx >= 0) {
        int cl = req.substring(clIdx + 15).toInt();
        int bodyStart = req.indexOf("\r\n\r\n") + 4;
        if ((int)req.length() - bodyStart >= cl) break;
      } else break;
    }
    delay(1);
  }

  String logData = req.substring(0, min((int)req.length(), 64));

  if (req.startsWith("POST")) {
    int bs = req.indexOf("\r\n\r\n");
    String body = (bs >= 0) ? req.substring(bs + 4) : "";
    String prompt = extractJsonStr(body, "prompt");
    if (prompt.length() == 0) prompt = extractJsonStr(body, "content");
    if (prompt.length() == 0) prompt = "(empty)";
    logData = prompt.substring(0, 64);

    String mirror = escapeJsonStr("answer: " + prompt);
    String jr = "{\"model\":\"llama3.1:8b\",\"created_at\":\"2025-06-15T10:30:00Z\","
                "\"response\":\"" + mirror + "\","
                "\"done\":true,\"total_duration\":284000000,"
                "\"load_duration\":1000000,\"prompt_eval_count\":1,"
                "\"eval_count\":1,\"eval_duration\":283000000}\n";
    client.print("HTTP/1.1 200 OK\r\n"
                 "Content-Type: application/x-ndjson\r\n"
                 "Content-Length: " + String(jr.length()) + "\r\n\r\n" + jr);
  } else {
    client.print("HTTP/1.1 200 OK\r\n"
                 "Content-Type: text/plain; charset=utf-8\r\n"
                 "Content-Length: 17\r\n\r\n"
                 "Ollama is running");
  }
  delay(50);
  client.stop();
  logEvent(ip, 11434, logData);
}

// ──────────────── Honeypot Loop ─────────────────────
void honeypotLoop() {
  // Telnet: IAC negotiation then login prompt (server-speaks-first)
  if (WiFiClient c = telnetServer.available()) {
    const uint8_t neg[] = {0xFF,0xFB,0x01,0xFF,0xFB,0x03,0xFF,0xFD,0x03};
    c.write(neg, sizeof(neg));
    handleServerBanner(c, 23, "\r\nUbuntu 20.04.5 LTS\r\nlogin: ");
  }

  // FTP: server-speaks-first (RFC 959 §5.4)
  if (WiFiClient c = ftpServer.available())
    handleServerBanner(c, 21, "220 ProFTPD 1.3.7c Server (Debian) [::ffff:192.168.1.10]\r\n");

  // SSH: server-speaks-first, \r\n required (RFC 4253 §4.2)
  if (WiFiClient c = sshServer.available()) {
    String ip = c.remoteIP().toString();
    c.print("SSH-2.0-OpenSSH_8.5p1 Debian-1\r\n");
    String payload = dumpBytes(c, 256, 500);
    logEvent(ip, 22, payload);
    unsigned long t0 = millis();
    while (c.connected() && millis() - t0 < 3000) delay(10);
    c.stop();
  }

  // SMTP: server-speaks-first (RFC 5321 §3.1)
  if (WiFiClient c = smtpServer.available())
    handleServerBanner(c, 25, "220 mail.local ESMTP Exim 4.94.2\r\n");

  // POP3: server-speaks-first (RFC 1939 §3)
  if (WiFiClient c = pop3Server.available())
    handleServerBanner(c, 110, "+OK Dovecot ready.\r\n");

  // IMAP: server-speaks-first (RFC 3501 §2.2)
  if (WiFiClient c = imapServer.available())
    handleServerBanner(c, 143, "* OK [CAPABILITY IMAP4rev1 LITERAL+ SASL-IR LOGIN-REFERRALS ID ENABLE IDLE] Dovecot ready.\r\n");

  // HTTPS: client-speaks-first
  if (WiFiClient c = httpsServer.available())
    handleBanner(c, 443,
      "HTTP/1.1 200 OK\r\nServer: Apache/2.4.52 (Debian)\r\n"
      "Content-Type: text/html\r\nContent-Length: 44\r\n\r\n"
      "<html><body><h1>It works!</h1></body></html>");

  // VNC: server-speaks-first (RFB §6.1.1)
  if (WiFiClient c = vncServer.available())
    handleServerBanner(c, 5900, "RFB 003.008\n");

  // DNS over TCP: client-speaks-first, AA bit set (RFC 1035)
  if (WiFiClient c = dnsServer.available()) {
    uint8_t query[514];
    int n = c.read(query, sizeof(query));
    if (n >= 14) {
      uint16_t id = (query[2] << 8) | query[3];
      static uint8_t resp[] = {
        0x00,0x00,0x85,0x80,0x00,0x01,0x00,0x01,0x00,0x00,0x00,0x00,
        0x07,'v','e','r','s','i','o','n',0x04,'b','i','n','d',0x00,
        0x00,0x10,0x00,0x03,0xC0,0x0C,0x00,0x10,0x00,0x03,0x00,0x00,
        0x00,0x00,0x00,0x07,0x06,'9','.','1','6','.','3'
      };
      resp[0] = id >> 8; resp[1] = id & 0xFF;
      uint16_t dLen = sizeof(resp);
      uint8_t pkt[dLen + 2];
      pkt[0] = dLen >> 8; pkt[1] = dLen & 0xFF;
      memcpy(pkt + 2, resp, dLen);
      handleBanner(c, 53, pkt, dLen + 2);
    } else { c.stop(); }
  }

  // SMB: client-speaks-first — fixed header alignment (MS-SMB)
  if (WiFiClient c = smbServer.available()) {
    static const uint8_t SMB[] = {
      // SMB Header (32 bytes)
      0xFF,0x53,0x4D,0x42,           // Protocol: \xFFSMB
      0x72,                           // Command: NEGOTIATE
      0x00,0x00,0x00,0x00,           // Status: SUCCESS
      0x88,                           // Flags: Reply | Canonicalized
      0x07,0xC8,                      // Flags2: Unicode|NT_STATUS|ExtSec
      0x00,0x00,                      // PIDHigh
      0x00,0x00,0x00,0x00,0x00,0x00,0x00,0x00, // Signature
      0x00,0x00,                      // Reserved
      0x00,0x00,                      // TID
      0x11,0x02,                      // PID
      0x00,0x01,                      // UID
      0x00,0x20,                      // MID
      // Body: Negotiate Response (Core)
      0x01,                           // WordCount = 1
      0x00,0x00,                      // DialectIndex = 0
      0x00,0x00,                      // ByteCount = 0
    };
    uint32_t len = sizeof(SMB);
    uint8_t pkt[len + 4];
    pkt[0]=0; pkt[1]=(len>>16)&0xFF; pkt[2]=(len>>8)&0xFF; pkt[3]=len&0xFF;
    memcpy(pkt+4, SMB, len);
    handleBanner(c, 445, pkt, len+4);
  }

  // MySQL: server-speaks-first — fixed reserved field (MySQL Protocol)
  if (WiFiClient c = mysqlServer.available()) {
    static const uint8_t MY[] = {
      0x0A,                                     // protocol_version = 10
      '5','.','7','.','3','3',0x00,             // server_version
      0x08,0x00,0x00,0x00,                      // connection_id = 8
      'r','a','n','d','s','a','l','t',           // auth_plugin_data_part1 (8B)
      0x00,                                      // filler
      0xFF,0xF7,                                 // capability_lower
      0x08,                                      // charset = latin1
      0x02,0x00,                                 // status = AUTOCOMMIT
      0xFF,0xC7,                                 // capability_upper
      0x15,                                      // auth_plugin_data_len = 21
      0x00,0x00,0x00,0x00,0x00,0x00,0x00,0x00,0x00,0x00, // reserved (10 zeros)
      'r','a','n','d','s','a','l','t','2',       // auth_plugin_data_part2
      0x00,0x00,0x00,0x00,                       // padding to 13 bytes
      0x00,                                      // null term
      'm','y','s','q','l','_','n','a','t','i','v','e',
      '_','p','a','s','s','w','o','r','d',0x00   // auth_plugin_name
    };
    uint8_t pkt[sizeof(MY)+4];
    pkt[0]=sizeof(MY)&0xFF; pkt[1]=(sizeof(MY)>>8)&0xFF;
    pkt[2]=(sizeof(MY)>>16)&0xFF; pkt[3]=0x00;
    memcpy(pkt+4, MY, sizeof(MY));
    handleServerBanner(c, 3306, pkt, sizeof(pkt));
  }

  // RDP: client-speaks-first — fixed selectedProtocol (MS-RDPBCGR §2.2.1.2)
  if (WiFiClient c = rdpServer.available()) {
    static const uint8_t RDP[] = {
      0x03,0x00,0x00,0x13,           // TPKT: version=3, length=19
      0x0E,                           // X.224 LI=14
      0xD0,                           // X.224 CC
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      0x00,0x00,0x00,0x00            // selectedProtocol = PROTOCOL_RDP
    };
    handleBanner(c, 3389, RDP, sizeof(RDP));
  }

  // Ollama: client-speaks-first (HTTP API on 11434)
  if (WiFiClient c = ollamaServer.available())
    handleOllama(c);

  // HTTP-Alt: client-speaks-first
  if (WiFiClient c = ahttpServer.available())
    handleBanner(c, 8080,
      "HTTP/1.1 200 OK\r\nServer: Apache/2.4.52 (Debian)\r\n"
      "Content-Type: text/html\r\nContent-Length: 44\r\n\r\n"
      "<html><body><h1>It works!</h1></body></html>");

  delay(10);
}

// ──────────────── Web API ───────────────────────────
void setupAPI() {
  webServer.addHandler(&sseStream);

  webServer.on("/", HTTP_GET, [](AsyncWebServerRequest* r) {
    AsyncWebServerResponse* resp = r->beginResponse_P(200, "text/html", DASHBOARD_HTML_GZ, DASHBOARD_HTML_GZ_LEN);
    resp->addHeader("Content-Encoding", "gzip");
    r->send(resp);
  });

  webServer.on("/setup", HTTP_GET, [](AsyncWebServerRequest* r) {
    AsyncWebServerResponse* resp = r->beginResponse_P(200, "text/html", SETUP_HTML_GZ, SETUP_HTML_GZ_LEN);
    resp->addHeader("Content-Encoding", "gzip");
    r->send(resp);
  });

  webServer.on("/config", HTTP_GET, [](AsyncWebServerRequest* r) {
    File f = SPIFFS.open(CONFIG_PATH, FILE_READ);
    if (!f) { r->send(500, "application/json", "{\"error\":\"no config\"}"); return; }
    String json = f.readString(); f.close();
    AsyncWebServerResponse* res = r->beginResponse(200, "application/json", json);
    res->addHeader("Cache-Control", "no-store");
    r->send(res);
  });

  webServer.on("/config", HTTP_POST, [](AsyncWebServerRequest* r){}, NULL,
    [](AsyncWebServerRequest* r, uint8_t* data, size_t len, size_t, size_t) {
      File f = SPIFFS.open(CONFIG_PATH, FILE_WRITE);
      if (!f) { r->send(500); return; }
      f.write(data, len); f.close();
      r->send(200, "application/json", "{\"status\":\"OK\"}");
    });

  webServer.on("/reboot", HTTP_POST, [](AsyncWebServerRequest* r) {
    r->send(200); delay(500); ESP.restart();
  });

  webServer.on("/reset", HTTP_POST, [](AsyncWebServerRequest* r) {
    SPIFFS.remove(CONFIG_PATH);
    SPIFFS.remove(EVENTS_PATH);
    SPIFFS.remove(STATS_PATH);
    ringWritePos = 0; ringTotalCount = 0; totalAllTime = 0;
    memset(portCounts, 0, sizeof(portCounts));
    topIPCount = 0; memset(weeklyBuckets, 0, sizeof(weeklyBuckets));
    r->send(200, "application/json", "{\"status\":\"OK\"}");
  });

  // ── /api/stats ──
  webServer.on("/api/stats", HTTP_GET, [](AsyncWebServerRequest* r) {
    uint32_t cnt = min(ringTotalCount, ringCapacity);
    uint32_t upSec = millis() / 1000;
    uint32_t rate = upSec > 0 ? (totalAllTime * 3600UL) / upSec : 0;
    size_t used = SPIFFS.usedBytes(), total = SPIFFS.totalBytes();
    uint8_t pct = total > 0 ? (used * 100) / total : 0;

    String j = "{\"total\":"; j += totalAllTime;
    j += ",\"events\":"; j += cnt;
    j += ",\"ips\":";    j += topIPCount;
    j += ",\"rate\":";   j += rate;
    j += ",\"uptime\":"; j += upSec;
    j += ",\"storage\":"; j += pct;
    j += ",\"ip\":\"";  j += WiFi.localIP().toString(); j += "\"";
    j += ",\"heap\":";  j += ESP.getFreeHeap();
    j += ",\"capacity\":"; j += ringCapacity;

    j += ",\"device\":\"ESP32\"";
    j += ",\"today\":"; j += lastStatsDay;
    j += ",\"heatmap\":[";
    for (int d = 0; d < 7; d++) {
      if (d) j += ",";
      j += "[";
      for (int h = 0; h < 24; h++) { if (h) j += ","; j += weeklyBuckets[d][h]; }
      j += "]";
    }
    j += "]";

    // Sort top IPs by count desc
    TopIPEntry sorted[MAX_TOP_IPS];
    memcpy(sorted, topIPs, sizeof(TopIPEntry) * topIPCount);
    for (int i = 0; i < topIPCount - 1; i++)
      for (int k = i + 1; k < topIPCount; k++)
        if (sorted[k].count > sorted[i].count) std::swap(sorted[i], sorted[k]);

    j += ",\"topIPs\":[";
    for (int i = 0; i < topIPCount; i++) {
      if (i) j += ",";
      char ip[16]; uint32ToIP(sorted[i].ip, ip);
      j += "[\""; j += ip; j += "\","; j += sorted[i].count; j += "]";
    }
    j += "]";

    // Port distribution sorted by count desc
    struct PD { uint16_t port; uint32_t count; };
    PD pds[PORT_COUNT];
    int pdc = 0;
    for (int i = 0; i < PORT_COUNT; i++)
      if (portCounts[i] > 0) pds[pdc++] = {PORT_LIST[i], portCounts[i]};
    for (int i = 0; i < pdc - 1; i++)
      for (int k = i + 1; k < pdc; k++)
        if (pds[k].count > pds[i].count) std::swap(pds[i], pds[k]);

    j += ",\"portDist\":[";
    for (int i = 0; i < pdc; i++) {
      if (i) j += ",";
      j += "["; j += pds[i].port; j += ","; j += pds[i].count; j += "]";
    }
    j += "]}";

    AsyncWebServerResponse* res = r->beginResponse(200, "application/json", j);
    res->addHeader("Cache-Control", "no-store");
    r->send(res);
  });

  // ── /api/events ──
  webServer.on("/api/events", HTTP_GET, [](AsyncWebServerRequest* r) {
    int page = 1, limit = 30;
    uint16_t fPort = 0;
    String fIP = "";

    if (r->hasParam("page"))  page  = r->getParam("page")->value().toInt();
    if (r->hasParam("limit")) limit = constrain(r->getParam("limit")->value().toInt(), 1, 100);
    if (r->hasParam("port"))  fPort = r->getParam("port")->value().toInt();
    if (r->hasParam("ip"))    fIP   = r->getParam("ip")->value();

    uint32_t eventCount = min(ringTotalCount, ringCapacity);
    bool hasFilter = (fPort > 0 || fIP.length() > 0);

    FILE* f = fopen(EVENTS_VFS_PATH, "rb");
    if (!f) {
      r->send(200, "application/json", "{\"total\":0,\"page\":1,\"events\":[]}");
      return;
    }

    int skip = (page - 1) * limit;
    int totalMatch = 0, buffered = 0;
    EventRecord pageBuf[30];

    for (uint32_t i = 0; i < eventCount; i++) {
      uint32_t slot = (ringWritePos + ringCapacity - 1 - i) % ringCapacity;
      EventRecord rec;
      fseek(f, HEADER_SIZE + (long)slot * RECORD_SIZE, SEEK_SET);
      if (fread(&rec, 1, RECORD_SIZE, f) != RECORD_SIZE) continue;

      if (hasFilter) {
        if (fPort > 0 && rec.port != fPort) continue;
        if (fIP.length() > 0) {
          char ip[16]; uint32ToIP(rec.ip, ip);
          if (strstr(ip, fIP.c_str()) == NULL) continue;
        }
      }

      totalMatch++;
      if (totalMatch > skip && buffered < limit)
        pageBuf[buffered++] = rec;
    }
    fclose(f);

    int total = hasFilter ? totalMatch : (int)eventCount;

    AsyncResponseStream* res = r->beginResponseStream("application/json");
    res->addHeader("Cache-Control", "no-store");
    res->printf("{\"total\":%d,\"page\":%d,\"events\":[", total, page);

    for (int i = 0; i < buffered; i++) {
      if (i) res->print(",");
      char ip[16]; uint32ToIP(pageBuf[i].ip, ip);
      char esc[PAYLOAD_LEN * 2 + 1];
      int ej = 0;
      for (int k = 0; k < PAYLOAD_LEN && pageBuf[i].payload[k]; k++) {
        char c = pageBuf[i].payload[k];
        if (c == '"' || c == '\\') esc[ej++] = '\\';
        if (c >= 32) esc[ej++] = c;
      }
      esc[ej] = 0;
      res->printf("{\"t\":%u,\"ip\":\"%s\",\"p\":%u,\"d\":\"%s\"}",
        pageBuf[i].timestamp, ip, pageBuf[i].port, esc);
    }

    res->print("]}");
    r->send(res);
  });

  // ── /api/clear ──
  webServer.on("/api/clear", HTTP_POST, [](AsyncWebServerRequest* r) {
    ringWritePos = 0;
    ringTotalCount = 0;
    FILE* f = fopen(EVENTS_VFS_PATH, "w+b");
    if (f) { fwrite(&ringWritePos,4,1,f); fwrite(&ringTotalCount,4,1,f); fclose(f); }
    totalAllTime = 0;
    memset(portCounts, 0, sizeof(portCounts));
    topIPCount = 0;
    memset(weeklyBuckets, 0, sizeof(weeklyBuckets));
    saveStats();
    r->send(200, "application/json", "{\"status\":\"OK\"}");
  });

  webServer.begin();
}

// ──────────────── WiFi Setup (AP mode) ──────────────
void setupAP() {
  WiFi.softAP("HoneypotSIEM", "HoneyPotSIEM123");
  Serial.println("[*] AP Mode: HoneypotSIEM / HoneyPotSIEM123");
  Serial.println("[+] Setup: http://" + WiFi.softAPIP().toString());
  setupAPI();
}

bool loadConfig() {
  File f = SPIFFS.open(CONFIG_PATH, FILE_READ);
  if (!f || f.size() == 0) return false;
  JsonDocument doc;
  if (deserializeJson(doc, f)) { f.close(); return false; }
  f.close();

  ssid       = doc["ssid"].as<String>();
  password   = doc["password"].as<String>();
  WebhookURL = doc["webhook"].as<String>();
  enabledPorts.clear();
  for (JsonVariant p : doc["ports"].as<JsonArray>())
    enabledPorts.push_back(p.as<uint16_t>());

  return ssid.length() > 0 && password.length() > 0;
}

void startHoneypotServers() {
  auto tryBegin = [](uint16_t port, WiFiServer& srv) {
    if (std::find(enabledPorts.begin(), enabledPorts.end(), port) != enabledPorts.end()) {
      srv.begin();
      Serial.printf("[+] Port %u enabled\n", port);
    }
  };
  tryBegin(21,  ftpServer);   tryBegin(22,  sshServer);
  tryBegin(23,  telnetServer);tryBegin(25,  smtpServer);
  tryBegin(53,  dnsServer);   tryBegin(110, pop3Server);
  tryBegin(143, imapServer);  tryBegin(443, httpsServer);
  tryBegin(445, smbServer);   tryBegin(3306,mysqlServer);
  tryBegin(3389,rdpServer);   tryBegin(5900,vncServer);
  tryBegin(8080,ahttpServer);
  tryBegin(11434,ollamaServer);
}

// ──────────────── Setup & Loop ──────────────────────
void setup() {
  Serial.begin(115200);

  if (!SPIFFS.begin(true)) {
    Serial.println("[!] SPIFFS failed");
    return;
  }

  if (!SPIFFS.exists(CONFIG_PATH)) {
    File f = SPIFFS.open(CONFIG_PATH, FILE_WRITE);
    if (f) {
      f.print("{\"ssid\":\"\",\"password\":\"\",\"webhook\":\"\",\"ports\":[21,22,23,25,53,110,143,443,445,3306,3389,5900,8080,11434]}");
      f.close();
    }
  }

  ringInit();
  loadStats();

  if (!loadConfig()) {
    setupAP();
    return;
  }

  WiFi.begin(ssid.c_str(), password.c_str());
  Serial.printf("[~] Connecting to %s ", ssid.c_str());

  unsigned long t0 = millis();
  while (WiFi.status() != WL_CONNECTED && millis() - t0 < 10000) {
    delay(500);
    Serial.print(".");
  }

  if (WiFi.status() != WL_CONNECTED) {
    Serial.println("\n[!] WiFi failed");
    setupAP();
    return;
  }

  Serial.printf("\n[+] Connected: %s\n", WiFi.localIP().toString().c_str());

  configTime(0, 0, "pool.ntp.org", "time.nist.gov");
  Serial.print("[~] NTP sync...");
  struct tm ti;
  int retry = 0;
  while (!getLocalTime(&ti) && retry++ < 10) delay(500);
  if (retry < 10) Serial.printf(" OK %04d-%02d-%02d %02d:%02d\n",
    ti.tm_year+1900, ti.tm_mon+1, ti.tm_mday, ti.tm_hour, ti.tm_min);
  else Serial.println(" timeout (using millis)");

  setupAPI();
  startHoneypotServers();
  honeypotActive = true;
}

void loop() {
  if (!honeypotActive) {
    delay(100);
    return;
  }
  honeypotLoop();
}
